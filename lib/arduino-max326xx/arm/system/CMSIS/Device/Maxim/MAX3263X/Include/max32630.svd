# max32630 register map
Vendor: Maxim Integrated; Series: ARMCM4; File version: 1.1
The MAX32630/1 device family is designed for wearable and portable medical and fitness applications. The devices contain an ARM Cortex-M4 processor with FPU, execute up to 96MHz and include a 10-bit ADC and a versatile set of on-chip peripherals.
CPU: CM4 r1p0, little endian, no MPU, FPU, 3 interrupt priority bits
Registers are 32-bit, read-write, reset 0x0 unless marked. A register's access mark holds for its fields unless they carry their own. Offsets are from the block's base; lines under a group give offsets from that group; [hi:lo] are bit positions; {n}, {i} and the like mark numbered series; 'fields as' and 'values as' point back to an identical list; <NAME> marks a mode.

## Memory map
0x40000400 CLKMAN size 0x400 — System Clock Manager
0x40000800 PWRMAN size 0x200 — System Power Manager
0x40000A00 RTCTMR size 0x30 — Real Time Clock
0x40000A30 PWRSEQ size 0x40 — Power Sequencer
0x40000A70 RTCCFG size 0x90 — RTC Configuration Register
0x40000C00 IOMAN size 0x400 — System I/O Manager
0x40002000 FLC size 0x1000 — Flash Controller
0x40003000 ICC size 0x1000 — Instruction Cache Controller
0x40004000 SPIX size 0x1000 — SPI XIP Interface
0x40005000 PMU0 size 0x20 — Peripheral Management Unit
0x40005020 PMU1 size 0x20
0x40005040 PMU2 size 0x20
0x40005060 PMU3 size 0x20
0x40005080 PMU4 size 0x20
0x400050A0 PMU5 size 0x20
0x40006000 CRC size 0x1000 — CRC-16/CRC-32 Engine
0x40007000 TPU size 0x400 — Trust Protection Unit (TPU)
0x40007400 AES size 0x400 — AES Cryptographic Engine
0x40007800 MAA size 0x400 — MAA Cryptographic Engine
0x40007C00 TPU_TSR size 0x400 — Trust Protection Unit (TPU)
0x40008000 WDT0 size 0x1000 — Watchdog Timers
0x40009000 WDT1 size 0x1000
0x4000A000 GPIO size 0x1000 — General Purpose I/O Ports (GPIO)
0x4000B000 TMR0 size 0x1000 — 16/32 bit Timer/Counters
0x4000C000 TMR1 size 0x1000
0x4000D000 TMR2 size 0x1000
0x4000E000 TMR3 size 0x1000
0x4000F000 TMR4 size 0x1000
0x40010000 TMR5 size 0x1000
0x40011000 PTG size 0x10 — Pulse Train Generation
0x40011010 PT0 size 0xC — Pulse Train Generation
{0x40011010+0xC*n} PT{n} size 0xC (n=1..15)
0x40012000 UART0 size 0x1000 — UART / Serial Port Interface
0x40013000 UART1 size 0x1000
0x40014000 UART2 size 0x1000
0x40015000 UART3 size 0x1000
0x40016000 I2CM0 size 0x1000 — I2C Master 0 Interface
0x40017000 I2CM1 size 0x1000
0x40018000 I2CM2 size 0x1000
0x40019000 I2CS size 0x1000 — I2C Slave Interface
0x4001A000 SPIM0 size 0x1000 — SPI Master Interface
0x4001B000 SPIM1 size 0x1000
0x4001C000 SPIM2 size 0x1000
0x4001E000 OWM size 0x1000 — 1-Wire Master Interface
0x4001F000 ADC size 0x1000 — 10-bit Analog to Digital Converter
0x40020000 SPIS size 0x1000 — SPI Slave Interface
0x40100000 USB size 0x1000 — USB Device Controller

## Interrupts
0 CLKMAN — Clock Management IRQ
1 PowerManager (PWRMAN) — Power Manager IRQ
2 FLC — Flash Controller IRQ
3 RTC_COMP0 (RTCTMR) — RTC Compare 0 IRQ
4 RTC_COMP1 (RTCTMR) — RTC Compare 1 IRQ
5 RTC_PRESCALE_COMP (RTCTMR) — RTC Prescale Compare IRQ
6 RTC_OVERFLOW (RTCTMR) — RTC Overflow IRQ
7 PMU (PMU0) — Peripheral Manament IRQ
8 USB — USB IRQ
9 AES — AES IRQ
10 MAA — Modular Arithematic Accelerator IRQ
11 WDT0 — Watch Dog Timer 0 IRQ
12 WDT0_PRE_WIN (WDT0) — Watch Dog Timer 0 Pre-Window IRQ
13 WDT1 — Watch Dog Timer 1 IRQ
14 WDT1_PRE_WIN (WDT1) — Watch Dog Timer 1 Pre-Window IRQ
15 GPIO0 (GPIO) — GPIO Port 0 IRQ
16 GPIO1 (GPIO) — GPIO Port 1 IRQ
17 GPIO2 (GPIO) — GPIO Port 2 IRQ
18 GPIO3 (GPIO) — GPIO Port 3 IRQ
19 GPIO4 (GPIO) — GPIO Port 4 IRQ
20 GPIO5 (GPIO) — GPIO Port 5 IRQ
21 GPIO6 (GPIO) — GPIO Port 6 IRQ
22 TMR0 — Timer 0 IRQ
23 TMR16_0 (TMR0) — 16-bit Timer 0 IRQ
24 TMR1 — Timer 1 IRQ
25 TMR16_1 (TMR1) — 16-bit Timer 1 IRQ
26 TMR2 — Timer 2 IRQ
27 TMR16_2 (TMR2) — 16-bit Timer 2 IRQ
28 TMR3 — Timer 3 IRQ
29 TMR16_3 (TMR3) — 16-bit Timer 3 IRQ
30 TMR4 — Timer 4 IRQ
31 TMR16_4 (TMR4) — 16-bit Timer 4 IRQ
32 TMR5 — Timer 5 IRQ
33 TMR16_5 (TMR5) — 16-bit Timer 5 IRQ
34 UART0 — UART 0 IRQ
35 UART1 — UART 1 IRQ
36 UART2 — UART 2 IRQ
37 UART3 — UART 3 IRQ
38 PT (PTG) — Pulse Train IRQ
39 I2CM0 — I2C Master 0 IRQ
40 I2CM1 — I2C Master 1 IRQ
41 I2CM2 — I2C Master 2 IRQ
42 I2CS — I2C Slave IRQ
43 SPIM0 — SPI Master 0 IRQ
44 SPIM1 — SPI Master 1 IRQ
45 SPIM2 — SPI Master 2 IRQ
47 OWM — 1-Wire Master IRQ
48 ADC — ADC IRQ
49 SPIS — SPI Slave IRQ
50 GPIO7 (GPIO) — GPIO Port 7 IRQ
51 GPIO8 (GPIO) — GPIO Port 8 IRQ

## Licence text in the file
Copyright (C) 2017 Maxim Integrated Products, Inc., All Rights Reserved. . Permission is hereby granted, free of charge, to any person obtaining a copy of this software and associated documentation files (the "Software"), to deal in the Software without restriction, including without limitation the rights to use, copy, modify, merge, publish, distribute, sublicense, and/or sell copies of the Software, and to permit persons to whom the. Software is furnished to do so, subject to the following conditions: . The above copyright notice and this permission notice shall be included in all copies or substantial portions of the Software. . THE SOFTWARE IS PROVIDED "AS IS", WITHOUT WARRANTY OF ANY KIND, EXPRESS. OR IMPLIED, INCLUDING BUT NOT LIMITED TO THE WARRANTIES OF. MERCHANTABILITY, FITNESS FOR A PARTICULAR PURPOSE AND NONINFRINGEMENT. IN NO EVENT SHALL MAXIM INTEGRATED BE LIABLE FOR ANY CLAIM, DAMAGES . OR OTHER LIABILITY, WHETHER IN AN ACTION OF CONTRACT, TORT OR OTHERWISE, ARISING FROM, OUT OF OR IN CONNECTION WITH THE SOFTWARE OR THE USE OR. OTHER DEALINGS IN THE SOFTWARE. . Except as contained in this notice, the name of Maxim Integrated. Products, Inc. shall not be used except as stated in the Maxim Integrated. Products, Inc. Branding Policy. . The mere transfer of this software does not imply any licenses of trade secrets, proprietary technology, copyrights, patents, trademarks, maskwork rights, or any other form of intellectual property whatsoever. Maxim Integrated Products, Inc. retains all ownership rights.
